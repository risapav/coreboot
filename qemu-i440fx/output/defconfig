## qemu-i440fx/output/defconfig
```kconfig
CONFIG_CCACHE=y
CONFIG_USE_OPTION_TABLE=y
CONFIG_BOOTSPLASH_IMAGE=y
CONFIG_BOOTSPLASH_FILE="/home/coreboot/qemu-i440fx/stock_bios/bootsplash.jpg"
CONFIG_MAINBOARD_VENDOR="QEMU"
CONFIG_CBFS_SIZE=0x300000
CONFIG_ONBOARD_VGA_IS_PRIMARY=y
# CONFIG_POST_IO is not set
# CONFIG_POST_DEVICE is not set
CONFIG_PCIEXP_HOTPLUG_BUSES=8
CONFIG_PCIEXP_HOTPLUG_MEM=0x800000
CONFIG_PCIEXP_HOTPLUG_PREFETCH_MEM=0x10000000
# CONFIG_DRIVERS_UART_8250IO is not set
CONFIG_PCIEXP_ASPM=y
CONFIG_PCIEXP_COMMON_CLOCK=y
CONFIG_UART_PCI_ADDR=0x0
CONFIG_PCIEXP_HOTPLUG=y
CONFIG_GENERIC_LINEAR_FRAMEBUFFER=y
CONFIG_BOOTSPLASH=y
CONFIG_PCIEXP_HOTPLUG_IO=0x2000
CONFIG_SUBSYSTEM_VENDOR_ID=0x0000
CONFIG_SUBSYSTEM_DEVICE_ID=0x0000
CONFIG_DRIVERS_EMULATION_QEMU_BOCHS_XRES=800
CONFIG_DRIVERS_EMULATION_QEMU_BOCHS_YRES=600
CONFIG_DRIVERS_PS2_KEYBOARD=y
# CONFIG_BOOTBLOCK_CONSOLE is not set
# CONFIG_POSTCAR_CONSOLE is not set
# CONFIG_SQUELCH_EARLY_SMP is not set
# CONFIG_CONSOLE_CBMEM is not set
CONFIG_CONSOLE_QEMU_DEBUGCON_PORT=0x402
CONFIG_DEFAULT_CONSOLE_LOGLEVEL_8=y
CONFIG_SEABIOS_DEBUG_LEVEL=-1
```

## t410/defconfig
```kconfig
#
# General setup
#
CONFIG_COREBOOT_BUILD=y
CONFIG_CBFS_PREFIX="fallback"
CONFIG_COMPILER_GCC=y
CONFIG_USE_OPTION_TABLE=y
CONFIG_COMPRESS_RAMSTAGE=y
CONFIG_INCLUDE_CONFIG_FILE=y
CONFIG_COLLECT_TIMESTAMPS=y
CONFIG_USE_BLOBS=y
# CONFIG_BOOTSPLASH_IMAGE is not set

#
# Mainboard
#

CONFIG_VENDOR_LENOVO=y
CONFIG_BOARD_SPECIFIC_OPTIONS=y
CONFIG_MAINBOARD_FAMILY="ThinkPad T410"
CONFIG_MAINBOARD_PART_NUMBER="ThinkPad T410"
CONFIG_MAINBOARD_VERSION="1.0"
CONFIG_MAINBOARD_DIR="lenovo/t410"
CONFIG_VGA_BIOS_ID="8086,0046"
CONFIG_DIMM_MAX=4
CONFIG_DIMM_SPD_SIZE=256
CONFIG_FMDFILE=""
# CONFIG_NO_POST is not set
CONFIG_MAINBOARD_VENDOR="LENOVO"
CONFIG_CBFS_SIZE=0x300000
CONFIG_ONBOARD_VGA_IS_PRIMARY=y
CONFIG_MAX_CPUS=8
# CONFIG_VBOOT is not set
CONFIG_VBOOT_VBNV_OFFSET=0x2a
CONFIG_DEVICETREE="devicetree.cb"
# CONFIG_VGA_BIOS is not set
CONFIG_MAINBOARD_SMBIOS_MANUFACTURER="LENOVO"
CONFIG_DRAM_RESET_GATE_GPIO=10
CONFIG_INTEL_GMA_VBT_FILE="src/mainboard/$(MAINBOARDDIR)/data.vbt"
CONFIG_PRERAM_CBMEM_CONSOLE_SIZE=0xc00


CONFIG_IFD_BIN_PATH="3rdparty/blobs/mainboard/$(MAINBOARDDIR)/descriptor.bin"
CONFIG_ME_BIN_PATH="3rdparty/blobs/mainboard/$(MAINBOARDDIR)/me.bin"
CONFIG_GBE_BIN_PATH="3rdparty/blobs/mainboard/$(MAINBOARDDIR)/gbe.bin"
CONFIG_CONSOLE_CBMEM_BUFFER_SIZE=0x20000
CONFIG_TIANOCORE_BOOT_TIMEOUT=2
CONFIG_MAINBOARD_SMBIOS_PRODUCT_NAME="ThinkPad T410"
CONFIG_HAVE_IFD_BIN=y

#
# Devices
#
CONFIG_HAVE_VGA_TEXT_FRAMEBUFFER=y
CONFIG_HAVE_LINEAR_FRAMEBUFFER=y
CONFIG_MAINBOARD_HAS_LIBGFXINIT=y
CONFIG_MAINBOARD_USE_LIBGFXINIT=y
# CONFIG_VGA_ROM_RUN is not set
# CONFIG_NO_GFX_INIT is not set

#
# Display
#
CONFIG_WANT_LINEAR_FRAMEBUFFER=y
# CONFIG_VGA_TEXT_FRAMEBUFFER is not set
CONFIG_GENERIC_LINEAR_FRAMEBUFFER=y
CONFIG_LINEAR_FRAMEBUFFER=y
CONFIG_BOOTSPLASH=y
# end of Display

CONFIG_LINEAR_FRAMEBUFFER_MAX_WIDTH=1280
CONFIG_LINEAR_FRAMEBUFFER_MAX_HEIGHT=800

#
# Console
#
# CONFIG_BOOTBLOCK_CONSOLE is not set
# CONFIG_POSTCAR_CONSOLE is not set
# CONFIG_SQUELCH_EARLY_SMP is not set
# CONFIG_SPKMODEM is not set
# CONFIG_CONSOLE_NE2K is not set
CONFIG_CONSOLE_CBMEM=y
# CONFIG_CONSOLE_CBMEM_DUMP_TO_UART is not set
# CONFIG_CONSOLE_SPI_FLASH is not set
CONFIG_DEFAULT_CONSOLE_LOGLEVEL_8=y
# CONFIG_DEFAULT_CONSOLE_LOGLEVEL_7 is not set
# CONFIG_DEFAULT_CONSOLE_LOGLEVEL_6 is not set
# CONFIG_DEFAULT_CONSOLE_LOGLEVEL_5 is not set
# CONFIG_DEFAULT_CONSOLE_LOGLEVEL_4 is not set
# CONFIG_DEFAULT_CONSOLE_LOGLEVEL_3 is not set
# CONFIG_DEFAULT_CONSOLE_LOGLEVEL_2 is not set
# CONFIG_DEFAULT_CONSOLE_LOGLEVEL_1 is not set
# CONFIG_DEFAULT_CONSOLE_LOGLEVEL_0 is not set
CONFIG_DEFAULT_CONSOLE_LOGLEVEL=8
# CONFIG_CMOS_POST is not set
CONFIG_HWBASE_DEBUG_CB=y
# end of Console

#
# System tables
#
CONFIG_GENERATE_SMBIOS_TABLES=y
CONFIG_SMBIOS_PROVIDED_BY_MOBO=y
CONFIG_MAINBOARD_SERIAL_NUMBER="123456789"
# end of System tables

#
# Payload
#
# CONFIG_PAYLOAD_NONE is not set
# CONFIG_PAYLOAD_ELF is not set
# CONFIG_PAYLOAD_BOOTBOOT is not set
# CONFIG_PAYLOAD_FILO is not set
# CONFIG_PAYLOAD_GRUB2 is not set
# CONFIG_PAYLOAD_LINUXBOOT is not set
# CONFIG_PAYLOAD_SEABIOS is not set
# CONFIG_PAYLOAD_UBOOT is not set
# CONFIG_PAYLOAD_YABITS is not set
# CONFIG_PAYLOAD_LINUX is not set
CONFIG_PAYLOAD_TIANOCORE=y
CONFIG_PAYLOAD_FILE="payloads/external/tianocore/tianocore/Build/UEFIPAYLOAD.fd"
CONFIG_PAYLOAD_OPTIONS=""
# CONFIG_PXE is not set
# CONFIG_TIANOCORE_UEFIPAYLOAD is not set
CONFIG_TIANOCORE_UPSTREAM=y
# CONFIG_TIANOCORE_COREBOOTPAYLOAD is not set
CONFIG_TIANOCORE_REVISION_ID=""
# CONFIG_TIANOCORE_DEBUG is not set
CONFIG_TIANOCORE_RELEASE=y
# CONFIG_COMPRESSED_PAYLOAD_NONE is not set
CONFIG_COMPRESSED_PAYLOAD_LZMA=y
# CONFIG_COMPRESSED_PAYLOAD_LZ4 is not set
CONFIG_COMPRESS_SECONDARY_PAYLOAD=y

#
# Secondary Payloads
#
CONFIG_COREINFO_SECONDARY_PAYLOAD=y
CONFIG_MEMTEST_SECONDARY_PAYLOAD=y
CONFIG_NVRAMCUI_SECONDARY_PAYLOAD=y
# CONFIG_TINT_SECONDARY_PAYLOAD is not set
# CONFIG_MEMTEST_STABLE is not set
CONFIG_MEMTEST_MASTER=y
# CONFIG_MEMTEST_REVISION is not set
# end of Secondary Payloads
# end of Payload

#
# General Debug Settings
#
# CONFIG_FATAL_ASSERTS is not set
# CONFIG_DEBUG_CBFS is not set
CONFIG_HAVE_DEBUG_RAM_SETUP=y
# CONFIG_DEBUG_RAM_SETUP is not set
CONFIG_HAVE_DEBUG_SMBUS=y
# CONFIG_DEBUG_SMBUS is not set
# CONFIG_DEBUG_SMI is not set
# CONFIG_DEBUG_MALLOC is not set
# CONFIG_DEBUG_RESOURCES is not set
# CONFIG_DEBUG_CONSOLE_INIT is not set
# CONFIG_DEBUG_SPI_FLASH is not set
# CONFIG_DEBUG_FUNC is not set
# CONFIG_DEBUG_BOOT_STATE is not set
# CONFIG_DEBUG_ADA_CODE is not set
CONFIG_HAVE_EM100_SUPPORT=y
# CONFIG_EM100 is not set
# end of Debugging
```

## t410/output/defconfig
```kconfig
CONFIG_CCACHE=y
CONFIG_USE_OPTION_TABLE=y
CONFIG_NO_STAGE_CACHE=y
CONFIG_BOOTSPLASH_IMAGE=y
CONFIG_BOOTSPLASH_FILE="/home/coreboot/t410/stock_bios/bootsplash.jpg"
CONFIG_VENDOR_LENOVO=y
CONFIG_CBFS_SIZE=0x300000
# CONFIG_POST_IO is not set
# CONFIG_POST_DEVICE is not set
CONFIG_LINEAR_FRAMEBUFFER_MAX_WIDTH=1280
CONFIG_LINEAR_FRAMEBUFFER_MAX_HEIGHT=800
CONFIG_HAVE_IFD_BIN=y
CONFIG_PCIEXP_HOTPLUG_BUSES=32
CONFIG_PCIEXP_HOTPLUG_MEM=0x800000
CONFIG_PCIEXP_HOTPLUG_PREFETCH_MEM=0x10000000
CONFIG_BOARD_LENOVO_T410=y
CONFIG_UART_PCI_ADDR=0x0
CONFIG_PCIEXP_HOTPLUG=y
CONFIG_HAVE_ME_BIN=y
CONFIG_ME_REGION_ALLOW_CPU_READ_ACCESS=y
CONFIG_HAVE_GBE_BIN=y
CONFIG_PCIEXP_HOTPLUG_IO=0x2000
CONFIG_SUBSYSTEM_VENDOR_ID=0x0000
CONFIG_SUBSYSTEM_DEVICE_ID=0x0000
CONFIG_ELOG=y
# CONFIG_SMMSTORE_V2 is not set
CONFIG_SMMSTORE_SIZE=0x40000
CONFIG_DRIVERS_PS2_KEYBOARD=y
CONFIG_NO_TPM=y
# CONFIG_BOOTBLOCK_CONSOLE is not set
# CONFIG_POSTCAR_CONSOLE is not set
# CONFIG_SQUELCH_EARLY_SMP is not set
# CONFIG_CONSOLE_CBMEM is not set
CONFIG_DEFAULT_CONSOLE_LOGLEVEL_8=y
CONFIG_PAYLOAD_TIANOCORE=y
CONFIG_MEMTEST_SECONDARY_PAYLOAD=y
```

## t430/defconfig
```kconfig
CONFIG_CCACHE=y
CONFIG_USE_OPTION_TABLE=y
CONFIG_BOOTSPLASH_IMAGE=y
CONFIG_BOOTSPLASH_FILE="/home/coreboot/t430/stock_bios/bootsplash.jpg"
CONFIG_VENDOR_LENOVO=y
CONFIG_CBFS_SIZE=0x300000
# CONFIG_POST_IO is not set
# CONFIG_POST_DEVICE is not set
CONFIG_SEABIOS_PS2_TIMEOUT=5000
CONFIG_LINEAR_FRAMEBUFFER_MAX_WIDTH=1600
CONFIG_LINEAR_FRAMEBUFFER_MAX_HEIGHT=900
CONFIG_HAVE_IFD_BIN=y
CONFIG_PCIEXP_HOTPLUG_BUSES=8
CONFIG_PCIEXP_HOTPLUG_MEM=0x800000
CONFIG_PCIEXP_HOTPLUG_PREFETCH_MEM=0x10000000
CONFIG_BOARD_LENOVO_THINKPAD_T430=y
CONFIG_UART_PCI_ADDR=0x0
# CONFIG_H8_BEEP_ON_DEATH is not set
CONFIG_HAVE_ME_BIN=y
CONFIG_USE_ME_CLEANER=y
CONFIG_HAVE_GBE_BIN=y
CONFIG_GENERIC_LINEAR_FRAMEBUFFER=y
CONFIG_BOOTSPLASH=y
CONFIG_PCIEXP_HOTPLUG_IO=0x2000
CONFIG_SUBSYSTEM_VENDOR_ID=0x0000
CONFIG_SUBSYSTEM_DEVICE_ID=0x0000
CONFIG_DRIVERS_PS2_KEYBOARD=y
# CONFIG_NO_TPM=y
# CONFIG_BOOTBLOCK_CONSOLE is not set
# CONFIG_POSTCAR_CONSOLE is not set
# CONFIG_SQUELCH_EARLY_SMP is not set
# CONFIG_CONSOLE_CBMEM is not set
CONFIG_DEFAULT_CONSOLE_LOGLEVEL_8=y
CONFIG_SEABIOS_DEBUG_LEVEL=-1
# CONFIG_COMPRESS_SECONDARY_PAYLOAD is not set
```

## t430/output/defconfig
```kconfig
CONFIG_CCACHE=y
CONFIG_BOOTSPLASH_IMAGE=y
CONFIG_BOOTSPLASH_FILE="/home/coreboot/t430/stock_bios/bootsplash.jpg"
CONFIG_VENDOR_LENOVO=y
CONFIG_CBFS_SIZE=0x400000
# CONFIG_POST_IO is not set
# CONFIG_POST_DEVICE is not set
CONFIG_LINEAR_FRAMEBUFFER_MAX_WIDTH=1600
CONFIG_LINEAR_FRAMEBUFFER_MAX_HEIGHT=900
CONFIG_HAVE_IFD_BIN=y
CONFIG_PCIEXP_HOTPLUG_BUSES=8
CONFIG_PCIEXP_HOTPLUG_MEM=0x800000
CONFIG_PCIEXP_HOTPLUG_PREFETCH_MEM=0x10000000
CONFIG_BOARD_LENOVO_THINKPAD_T430=y
CONFIG_UART_PCI_ADDR=0x0
# CONFIG_H8_BEEP_ON_DEATH is not set
CONFIG_HAVE_ME_BIN=y
CONFIG_ME_REGION_ALLOW_CPU_READ_ACCESS=y
CONFIG_HAVE_GBE_BIN=y
CONFIG_GENERIC_LINEAR_FRAMEBUFFER=y
CONFIG_BOOTSPLASH=y
CONFIG_PCIEXP_HOTPLUG_IO=0x2000
CONFIG_SUBSYSTEM_VENDOR_ID=0x0000
CONFIG_SUBSYSTEM_DEVICE_ID=0x0000
CONFIG_DRIVERS_PS2_KEYBOARD=y
CONFIG_NO_TPM=y
# CONFIG_BOOTBLOCK_CONSOLE is not set
# CONFIG_POSTCAR_CONSOLE is not set
# CONFIG_SQUELCH_EARLY_SMP is not set
# CONFIG_CONSOLE_CBMEM is not set
CONFIG_DEFAULT_CONSOLE_LOGLEVEL_8=y
CONFIG_PAYLOAD_GRUB2=y
CONFIG_GRUB2_REVISION=y
CONFIG_GRUB2_EXTRA_MODULES="jpeg gfxmenu gfxterm_background luks gcry_sha256 gcry_rijndael all_video btrfs usbserial_ftdi usbserial_usbdebug cbfs usbserial_pl2303"
CONFIG_GRUB2_INCLUDE_RUNTIME_CONFIG_FILE=y
CONFIG_COREINFO_SECONDARY_PAYLOAD=y
CONFIG_NVRAMCUI_SECONDARY_PAYLOAD=y
```

## x220/defconfig
```kconfig
CONFIG_CCACHE=y
CONFIG_USE_OPTION_TABLE=y
CONFIG_NO_STAGE_CACHE=y
CONFIG_BOOTSPLASH_IMAGE=y
CONFIG_VENDOR_LENOVO=y
CONFIG_CBFS_SIZE=0x200000
CONFIG_LINEAR_FRAMEBUFFER_MAX_HEIGHT=1080
CONFIG_LINEAR_FRAMEBUFFER_MAX_WIDTH=1920
CONFIG_ONBOARD_VGA_IS_PRIMARY=y
# CONFIG_POST_DEVICE is not set
# CONFIG_POST_IO is not set
CONFIG_VGA_BIOS=y
CONFIG_HAVE_IFD_BIN=y
CONFIG_BOARD_LENOVO_X220=y
# CONFIG_PCIEXP_HOTPLUG is not set
CONFIG_HAVE_ME_BIN=y
CONFIG_USE_ME_CLEANER=y
CONFIG_HAVE_GBE_BIN=y
CONFIG_MAINBOARD_USE_LIBGFXINIT=y
CONFIG_GENERIC_LINEAR_FRAMEBUFFER=y
CONFIG_BOOTSPLASH=y
CONFIG_DRIVERS_PS2_KEYBOARD=y
CONFIG_NO_TPM=y
# CONFIG_BOOTBLOCK_CONSOLE is not set
# CONFIG_POSTCAR_CONSOLE is not set
# CONFIG_SQUELCH_EARLY_SMP is not set
# CONFIG_CONSOLE_CBMEM is not set
CONFIG_DEFAULT_CONSOLE_LOGLEVEL_8=y
```

## x220/output/defconfig
```kconfig
CONFIG_CCACHE=y
CONFIG_USE_OPTION_TABLE=y
CONFIG_NO_STAGE_CACHE=y
CONFIG_VENDOR_LENOVO=y
CONFIG_CBFS_SIZE=0x200000
# CONFIG_POST_IO is not set
# CONFIG_POST_DEVICE is not set
CONFIG_SEABIOS_PS2_TIMEOUT=5000
CONFIG_LINEAR_FRAMEBUFFER_MAX_WIDTH=1920
CONFIG_LINEAR_FRAMEBUFFER_MAX_HEIGHT=1080
CONFIG_HAVE_IFD_BIN=y
CONFIG_BOARD_LENOVO_X220=y
CONFIG_UART_PCI_ADDR=0x0
# CONFIG_PCIEXP_HOTPLUG is not set
CONFIG_HAVE_ME_BIN=y
CONFIG_USE_ME_CLEANER=y
CONFIG_HAVE_GBE_BIN=y
CONFIG_GENERIC_LINEAR_FRAMEBUFFER=y
CONFIG_SUBSYSTEM_VENDOR_ID=0x0000
CONFIG_SUBSYSTEM_DEVICE_ID=0x0000
CONFIG_DRIVERS_PS2_KEYBOARD=y
CONFIG_NO_TPM=y
# CONFIG_BOOTBLOCK_CONSOLE is not set
# CONFIG_POSTCAR_CONSOLE is not set
# CONFIG_SQUELCH_EARLY_SMP is not set
# CONFIG_CONSOLE_CBMEM is not set
CONFIG_DEFAULT_CONSOLE_LOGLEVEL_8=y
CONFIG_SEABIOS_DEBUG_LEVEL=-1
```
